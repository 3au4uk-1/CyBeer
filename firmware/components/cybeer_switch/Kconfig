## firmware/components/cybeer_switch/Kconfig
```kconfig
menu "CyBeer switch"

    config CYBEER_SWITCH_TEST
        bool "Enable switch test hooks (injected raw, skip GPIO)"
        default n
        help
            When enabled, cybeer_switch skips GPIO setup and uses
            cybeer_switch_test_set_raw() for deterministic unit tests.

endmenu
```

## firmware/sdkconfig.defaults
```kconfig
CONFIG_IDF_TARGET="esp32c3"
CONFIG_MBEDTLS_CERTIFICATE_BUNDLE=y
CONFIG_MBEDTLS_CERTIFICATE_BUNDLE_DEFAULT_FULL=y
CONFIG_BOOTLOADER_APP_ROLLBACK_ENABLE=y
CONFIG_ESPTOOLPY_FLASHSIZE_4MB=y
CONFIG_PARTITION_TABLE_CUSTOM=y
CONFIG_PARTITION_TABLE_CUSTOM_FILENAME="partitions.csv"
CONFIG_ESP_WIFI_SOFTAP_SSID_PREFIX="CyBeer"
CONFIG_LWIP_MAX_SOCKETS=12
CONFIG_HTTPD_MAX_REQ_HDR_LEN=1024
CONFIG_HTTPD_WS_SUPPORT=y
```
